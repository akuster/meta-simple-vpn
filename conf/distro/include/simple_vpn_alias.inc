## conf/distro/include/simple_vpn_alias.inc
```bitbake
IP_ADDRESS ?= "192.168.7.2"
IP_NETMASK ?= "255.255.255.0"
IP_GATEWAY ?= "192.168.7.1"
IP_NETWORK ?= "192.168.7.0"

VPN_LOCAL_IP ?= "${IP_ADDRESS}"
VPN_IP_IFACE ??= "${IFACE}"
VPN_IP_ADDRESS ??= "${IP_ADDRESS}"
VPN_IP_NETMASK ??= "${IP_NETMASK}"
VPN_IP_GATEWAY ??= "${IP_GATEWAY}"
VPN_IP_NETWORK ??= "${IP_NETWORK}"
VPN_IP_DNS_NAMESERVERS ??= "${IP_DNS_NAMESERVERS}"
CERT_DIR ??= "openvpn/ssl"
VPN_KEYS_DIR ?= "${sysconfdir}/${CERT_DIR}/"
VPN_CA ?= "ca.crt"
VPN_CERT ?= "server.crt"
VPN_KEY ?= "server.key"
VPN_DH ?= "dh.pem"
```

## conf/distro/simple-vpn.conf
```bitbake
DISTRO = "simple-vpn"
DISTRO_NAME = "Simple vpn Reference"
DISTRO_VERSION = "3.0"

require conf/distro/include/simple_vpn_alias.inc
DISABLE_ROOT ?= "False"
DISTRO_FEATURES = " acl xattr pci ext2 pam ipv4 ipv6 ipsec largefile usbhost 2fa"
CERT_AUTO_GEN ?= "1"

IMAGE_FEATURES_remove = "debug-tweaks"
#IMAGE_FEATURES_append = " read-only-rootfs"
IMAGE_ROOTFS_EXTRA_SPACE = "524288"
```

## conf/layer.conf
```bitbake
# We have a conf and classes directory, add to BBPATH
BBPATH .= ":${LAYERDIR}"

# We have recipes-* directories, add to BBFILES
BBFILES += "${LAYERDIR}/recipes-*/*/*.bb \
        ${LAYERDIR}/recipes-*/*/*.bbappend"

BBFILE_COLLECTIONS += "simple-vpn-layer"
BBFILE_PATTERN_simple-vpn-layer = "^${LAYERDIR}/"
BBFILE_PRIORITY_simple-vpn-layer = "5"

# This should only be incremented on significant changes that will
# cause compatibility issues with other layers
LAYERVERSION_simple-vpn-layer = "1"

LAYERDEPENDS_simple-vpn-layer = "core"
LAYERDEPENDS_simple-vpn-layer += "openembedded-layer"
LAYERDEPENDS_simple-vpn-layer += "meta-python"
LAYERDEPENDS_simple-vpn-layer += "networking-layer"
LAYERDEPENDS_simple-vpn-layer += "security"

LAYERSERIES_COMPAT_simple-vpn-layer = " zeus dunfell"


QB_NETWORK_DEVICE_append_simple-vpn =" -device e1000,netdev=net1,mac=52:54:00:12:34:03 -netdev tap,id=net1,ifname=tap1,script=no,downscript=no"
```

## wic/edgerouter_harden.wks
```
# short-description: Create SD card image for Edgerouter
# long-description: Create a partitioned SD card image for MIPS64 Edgerouter reference hardware.
part /boot --source bootimg-partition --ondisk sda --fstype=vfat --label boot --active --align 4 --size 16
part / --source rootfs --ondisk sda --fstype=ext4 --label root --align 4 --exclude-path var home
part /var --source rootfs --ondisk mmcblk1 --fstype=ext4 --label var --align 4 --rootfs-dir=${IMAGE_ROOTFS}/var --size 2G
part /home --source rootfs --ondisk mmcblk1 --fstype=ext4 --label home --align 4 --rootfs-dir=${IMAGE_ROOTFS}/home
```
